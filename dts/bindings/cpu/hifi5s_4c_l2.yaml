## dts/bindings/cpu/hifi5s_4c_l2.yaml
```yaml
# Copyright (c) 2024 Cadence Design Systems, Inc.
# SPDX-License-Identifier: Apache-2.0

description: Cadence Tensilica hifi5s_4c_l2 CPU

compatible: "hifi5s_4c_l2"

include: cpu.yaml
```

## dts/bindings/cpu/hifi5s_ao_7.yaml
```yaml
# Copyright (c) 2024 Cadence Design Systems, Inc.
# SPDX-License-Identifier: Apache-2.0

description: Cadence Tensilica hifi5s_ao_7 CPU

compatible: "hifi5s_ao_7"

include: cpu.yaml
```
