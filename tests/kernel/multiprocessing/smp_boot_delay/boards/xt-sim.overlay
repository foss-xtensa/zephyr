/*
 * Copyright (c) 2026 Cadence Design Systems, Inc.
 *
 * SPDX-License-Identifier: Apache-2.0
 */

/* Secondary CPUs must be left for run-time start. */
&cpu1 {
	zephyr,deferred-start;
};

&cpu2 {
	zephyr,deferred-start;
};

&cpu3 {
	zephyr,deferred-start;
};
